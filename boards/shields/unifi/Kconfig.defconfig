## boards/shields/unifi/Kconfig.defconfig
```kconfig
if SHIELD_UNIFI_LEFT

config ZMK_KEYBOARD_NAME
    default "UniFi"

config ZMK_SPLIT_ROLE_CENTRAL
    default y

endif

if SHIELD_UNIFI_LEFT || SHIELD_UNIFI_RIGHT

config ZMK_SPLIT
    default y

endif
```

## boards/shields/unifi/Kconfig.shield
```kconfig
config SHIELD_UNIFI_LEFT
    def_bool $(shields_list_contains,unifi_left)

config SHIELD_UNIFI_RIGHT
    def_bool $(shields_list_contains,unifi_right)
```
